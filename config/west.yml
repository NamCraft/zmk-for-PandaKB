## config/west.yml
```yaml
manifest:
  remotes:
    - name: zmkfirmware
      url-base: https://github.com/zmkfirmware
    - name: cormoran
      url-base: https://github.com/cormoran
    - name: mctechnology17
      url-base: https://github.com/mctechnology17

  projects:
    - name: zmk
      remote: cormoran
      revision: v0.3-branch+custom-studio-protocol+activity
      import: app/west.yml

    - name: zmk-module-ble-management
      remote: cormoran
      revision: studio-v0.3
      path: modules/zmk-module-ble-management

    - name: zmk-module-settings-rpc
      remote: cormoran
      revision: zmk-v0.3.0.0
      path: modules/zmk-module-settings-rpc

    - name: zmk-module-battery-history
      remote: cormoran
      revision: main
      path: modules/zmk-module-battery-history

    - name: zmk-nice-oled
      remote: mctechnology17
      revision: main
      path: modules/zmk-nice-oled

  self:
    path: config
```
